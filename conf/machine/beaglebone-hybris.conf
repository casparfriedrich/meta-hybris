## conf/machine/beaglebone-hybris.conf
```bitbake
DEFAULTTUNE ?= "cortexa8hf-neon"

require conf/machine/include/arm/armv7a/tune-cortexa8.inc

MACHINE_FEATURES = " \
    usbgadget \
    usbhost \
    vfat \
"

MACHINE_ESSENTIAL_EXTRA_RDEPENDS += " \
    kernel-image \
    kernel-devicetree \
"

MACHINE_EXTRA_RRECOMMENDS = " \
    kernel-modules \
"

SERIAL_CONSOLES = "115200;ttyS0"

# ############################################################################################### #
# Bootloader
PREFERRED_PROVIDER_virtual/bootloader ?= "u-boot"
UBOOT_MACHINE = "am335x_evm_defconfig"
SPL_BINARY = "MLO"
UBOOT_SUFFIX = "img"

# ############################################################################################### #
# Kernel
PREFERRED_PROVIDER_virtual/kernel ?= "linux-yocto"
KERNEL_IMAGETYPE = "zImage"
DTB_FILES = "am335x-boneblack.dtb"
KERNEL_DEVICETREE = '${@' '.join('ti/omap/%s' % d for d in '${DTB_FILES}'.split())}'

KERNEL_MODULE_AUTOLOAD += " \
    g_ncm \
"

KERNEL_MODULE_PROBECONF += " \
    g_ncm \
"

module_conf_g_ncm = "options g_ncm dev_addr=02:00:00:bb:00:00 host_addr=02:00:00:bb:00:01"

# ############################################################################################### #
# Image
IMAGE_FSTYPES += "tar.bz2 wic"
IMAGE_BOOT_FILES = "u-boot.${UBOOT_SUFFIX} ${SPL_BINARY} ${KERNEL_IMAGETYPE} ${DTB_FILES}"
EXTRA_IMAGEDEPENDS += "virtual/bootloader"

WKS_FILE = "${MACHINE}.wks.in"
```

## conf/distro/poky-hybris.conf
```bitbake
DISTRO = "poky-hybris"
DISTROOVERRIDES = "poky:poky-hybris"

DISTRO_FEATURES:append = " \
	"

DISTRO_FEATURES:remove = " \
	bluetooth \
	nfs \
	opengl \
	ptest \
	vulkan \
	wayland \
	wifi \
	x11 \
"

DISTRO_EXTRA_RDEPENDS:append = " \
	packagegroup-core-full-cmdline \
	packagegroup-hybris \
"

INIT_MANAGER = "systemd"

# Replace busybox with coreutils
PREFERRED_PROVIDER_virtual/base-utils = "packagegroup-core-base-utils"
VIRTUAL-RUNTIME_base-utils = "packagegroup-core-base-utils"
VIRTUAL-RUNTIME_base-utils-hwclock = "util-linux-hwclock"
VIRTUAL-RUNTIME_base-utils-syslog = ""

PREFERRED_RPROVIDER_libnss-mdns = "avahi-libnss-mdns"

require conf/distro/poky.conf
require conf/distro/include/gcsections.inc
```

## conf/layer.conf
```bitbake
BBPATH .= ":${LAYERDIR}"

BBFILES .= " \
	${LAYERDIR}/recipes-*/*/*.bb \
	${LAYERDIR}/recipes-*/*/*.bbappend \
	"

BBFILE_COLLECTIONS += "hybris-layer"
BBFILE_PATTERN_hybris-layer = "^${LAYERDIR}/"
BBFILE_PRIORITY_hybris-layer = "6"

LAYERSERIES_COMPAT_hybris-layer = "scarthgap walnascar whinlatter"
LAYERVERSION_hybris-layer = "1"
```

## conf/machine/phyboard-hybris.conf
```bitbake
include conf/machine/include/arm/armv7a/tune-cortexa9.inc

MACHINE_FEATURES = " \
	usbgadget \
	usbhost \
	vfat \
	"

MACHINE_ESSENTIAL_EXTRA_RDEPENDS += " \
	kernel-image \
	kernel-devicetree \
	"

MACHINE_EXTRA_RRECOMMENDS = " \
	kernel-modules \
	"

KERNEL_MODULE_AUTOLOAD += " \
	g_ether \
	"

SERIAL_CONSOLES = "115200;ttymxc1"

EXTRA_IMAGEDEPENDS += "virtual/bootloader"

# Kernel >>>
PREFERRED_PROVIDER_virtual/kernel ?= "linux-yocto"
KERNEL_IMAGETYPE = "zImage"
DTB_FILES = "imx6q-phytec-mira-rdk-nand.dtb"
KERNEL_DEVICETREE = '${@' '.join('nxp/imx/%s' % d for d in '${DTB_FILES}'.split())}'
# <<< Kernel

# Bootloader >>>
PREFERRED_PROVIDER_virtual/bootloader ?= "u-boot"
SPL_BINARY = "SPL"
UBOOT_SUFFIX = "img"
UBOOT_MACHINE = "mx6sabresd_defconfig"
# <<< Bootloader

# Image >>>
IMAGE_FSTYPES += "tar.bz2 wic wic.bmap"
IMAGE_BOOT_FILES = "u-boot.${UBOOT_SUFFIX} ${SPL_BINARY} ${KERNEL_IMAGETYPE} ${DTB_FILES}"
WKS_FILE = "beaglebone-hybris.wks"
# <<< Image
```

## conf/machine/phyboard-mira-hybris.conf
```bitbake
require conf/machine/phyboard-mira-imx6-3.conf

MACHINEOVERRIDES =. "phyboard-mira-imx6-3:"

KERNEL_MODULE_AUTOLOAD:append = " \
	g_ether \
	"
```

## wic/beaglebone-hybris.wks
```
part   --source bootimg-partition --fstype=vfat --label boot  --align 1024 --use-uuid --fixed-size 128M --active
part / --source rootfs            --fstype=ext4 --label sys_a --align 1024 --use-uuid --fixed-size 512M
part   --source rootfs            --fstype=ext4 --label sys_b --align 1024 --use-uuid --fixed-size 512M
```
